## firmware/tdongle-s3-bridge/main/Kconfig.projbuild
```kconfig
menu "T-Dongle-S3 status panel"

    config APP_BRIDGE_MODE
        bool "Run as USB-NCM Wi-Fi bridge"
        default y
        help
            Bridges layer-2 frames between the Wi-Fi station interface and a USB
            NCM network interface, so a USB host (the Raspberry Pi) gets its own
            DHCP lease from the real router. Requires USB OTG, which takes over
            the USB pins, so the USB serial console is unavailable in this mode.

            Disable to build a display-only image with the console on
            USB-Serial/JTAG (used to verify the panel driver over serial).

endmenu
```

## firmware/tdongle-s3-bridge/sdkconfig.defaults
```kconfig
CONFIG_IDF_TARGET="esp32s3"
CONFIG_ESPTOOLPY_FLASHSIZE_16MB=y
CONFIG_PARTITION_TABLE_CUSTOM=y
CONFIG_PARTITION_TABLE_CUSTOM_FILENAME="partitions.csv"
CONFIG_ESPTOOLPY_FLASHMODE_QIO=y
CONFIG_ESPTOOLPY_FLASHFREQ_80M=y
CONFIG_ESP32S3_DEFAULT_CPU_FREQ_240=y
CONFIG_ESP32S3_SPIRAM_SUPPORT=n
CONFIG_COMPILER_OPTIMIZATION_PERF=y
CONFIG_ESP_CONSOLE_NONE=y
CONFIG_APP_BRIDGE_MODE=y
CONFIG_TINYUSB_NET_MODE_NCM=y
CONFIG_TINYUSB_NET_MODE_NONE=n
CONFIG_FREERTOS_HZ=1000
```
